## config/west.yml
```yaml
manifest:
  remotes:
    - name: zmkfirmware
      url-base: https://github.com/zmkfirmware
    - name: tyamanak
      url-base: https://github.com/tyamanak
  projects:
    - name: zmk
      remote: zmkfirmware
      revision: main
      import: app/west.yml
    - name: zmk-pmw3610-driver
      remote: tyamanak
      revision: add_threshold_to_automouse
  self:
    path: config
```
